#include "oled.h"
#include "delay.h"
#include "spi.h"
/*FreeRTOS相关头文件*/
#include "FreeRTOS.h"
#include "task.h"
#include "semphr.h"

//常用ASCII表
//偏移量32
//ASCII字符集: !"#$%&'()*+,-./0123456789:;<=>?@ABCDEFGHIJKLMNOPQRSTUVWXYZ[\]^_`abcdefghijklmnopqrstuvwxyz{|}~
//PC2LCD2002取模方式设置：阴码+逐列式+顺向+C51格式
//12*12 ASCII字符集点阵
const uint8_t asc2_1206[95][12]= {
    {0x00,0x00,0x00,0x00,0x00,0x00,0x00,0x00,0x00,0x00,0x00,0x00},/*" ",0*/
    {0x00,0x00,0x00,0x00,0x3F,0x40,0x00,0x00,0x00,0x00,0x00,0x00},/*"!",1*/
    {0x00,0x00,0x30,0x00,0x40,0x00,0x30,0x00,0x40,0x00,0x00,0x00},/*""",2*/
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    {0x40,0x00,0x80,0x00,0x40,0x00,0x20,0x00,0x20,0x00,0x40,0x00},/*"~",94*/
};
//16*16 ASCII字符集点阵
const uint8_t asc2_1608[95][16]=
{
    {0x00,0x00,0x00,0x00,0x00,0x00,0x00,0x00,0x00,0x00,0x00,0x00,0x00,0x00,0x00,0x00},/*" ",0*/
    {0x00,0x00,0x00,0x00,0x00,0x00,0x1F,0xCC,0x00,0x0C,0x00,0x00,0x00,0x00,0x00,0x00},/*"!",1*/
    {0x00,0x00,0x08,0x00,0x30,0x00,0x60,0x00,0x08,0x00,0x30,0x00,0x60,0x00,0x00,0x00},/*""",2*/
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    {0x00,0x00,0x60,0x00,0x80,0x00,0x80,0x00,0x40,0x00,0x40,0x00,0x20,0x00,0x20,0x00},/*"~",94*/
};

#include "spi.h"

//OLED显存
uint8_t OLED_GRAM[OLED_W][OLED_H / 8];

//更新显存到LCD
void OLED_Refresh_Gram(void)
{
    uint16_t i,n;
    
    for(i=0; i<8; i++)
    {
        OLED_WR_Byte (0xb0+i,OLED_CMD);    //设置页地址（0~7）
        OLED_WR_Byte (0x02,OLED_CMD);      //设置显示位置—列低地址    //1.3寸oled 0x02
        OLED_WR_Byte (0x10,OLED_CMD);      //设置显示位置—列高地址
        for(n=0; n<OLED_W; n++)
        {
            OLED_WR_Byte(OLED_GRAM[n][i],OLED_DATA);
        }
    }
}

////SPI 速度设置函数
//void SPI2_SetSpeed(uint8_t SpeedSet)
//{
//    assert_param(IS_SPI_BAUDRATE_PRESCALER(SpeedSet));//判断有效性
//    __HAL_SPI_DISABLE(&hspi2);              //关闭SPI
//    hspi2.Instance->CR1&=0XFFC7;            //位3-5清零，用来设置波特率
//    hspi2.Instance->CR1|=SpeedSet;          //设置SPI速度
//    __HAL_SPI_ENABLE(&hspi2);               //使能SPI
//}

//SPIx 读写一个字节
uint8_t SPI2_ReadWriteByte(uint8_t TxData)
{
    uint8_t  Rxdata;
    //HAL_SPI_TransmitReceive(&hspi2,&TxData,&Rxdata,1, 1000);
    return Rxdata;  //返回收到的数据
}

static uint8_t registerRead(uint8_t reg)
{
    uint8_t data = 0;
    spiBeginTransaction();
    spiExchange(1, &reg, &data);
    spiEndTransaction();
    return data;
}

//向SSD1306写入一个字节。
//dat:要写入的数据/命令
//cmd:数据/命令标志 0,表示命令;1,表示数据;
void OLED_WR_Byte(uint8_t dat,uint8_t cmd)
{
    uint8_t i;
    if(cmd) //写命令
    {
        OLED_DC_H;
    }
    else
    {
        OLED_DC_L;
    }
    OLED_CS_L;
    #if (!USB_HW_SPI)
    for(i=0;i<8;i++)
    {
        OLED_D0_L;
    
        if(dat&0x80)
            OLED_D1_H;
        else 
            OLED_D1_L;
    
        OLED_D0_H;
    
        dat<<=1;
    }
    #else
    i = dat;
    //HAL_SPI_Transmit(&hspi2,&i,1,0xFF);
    registerRead(i);
    #endif
    OLED_CS_H;
    OLED_DC_H;
}

//开启OLED显示
void OLED_Display_On(void)
{
    OLED_WR_Byte(0X8D,OLED_CMD);  //SET DCDC命令
    OLED_WR_Byte(0X14,OLED_CMD);  //DCDC ON
    OLED_WR_Byte(0XAF,OLED_CMD);  //DISPLAY ON
}
//关闭OLED显示
void OLED_Display_Off(void)
{
    OLED_WR_Byte(0X8D,OLED_CMD);  //SET DCDC命令
    OLED_WR_Byte(0X10,OLED_CMD);  //DCDC OFF
    OLED_WR_Byte(0XAE,OLED_CMD);  //DISPLAY OFF
}

void OLED_SetDir(uint8_t para)
{
    if (para == 1)
    {
        OLED_WR_Byte(0xA0,OLED_CMD);/* A0 ：列地址0映射到SEG0; A1 ：列地址127映射到SEG0 */
        OLED_WR_Byte(0xC8,OLED_CMD);/* C0 ：正常扫描,从COM0到COM63;  C8 : 反向扫描, 从 COM63至 COM0 */
    }
    else if (para == 0)
    {
        OLED_WR_Byte(0xA1,OLED_CMD);/* A0 ：列地址0映射到SEG0; A1 ：列地址127映射到SEG0 */
        OLED_WR_Byte(0xC0,OLED_CMD);/* C0 ：正常扫描,从COM0到COM63;  C8 : 反向扫描, 从 COM63至 COM0 */
    }
    else if (para == 2)
    {
        OLED_WR_Byte(0xA0,OLED_CMD);/* A0 ：列地址0映射到SEG0; A1 ：列地址127映射到SEG0 */
        OLED_WR_Byte(0xC0,OLED_CMD);/* C0 ：正常扫描,从COM0到COM63;  C8 : 反向扫描, 从 COM63至 COM0 */
    }
    else if (para == 3)
    {
        OLED_WR_Byte(0xA1,OLED_CMD);/* A0 ：列地址0映射到SEG0; A1 ：列地址127映射到SEG0 */
        OLED_WR_Byte(0xC8,OLED_CMD);/* C0 ：正常扫描,从COM0到COM63;  C8 : 反向扫描, 从 COM63至 COM0 */
    }
}

void OLED_SetContrast(uint8_t para)
{
    OLED_WR_Byte(0x81,OLED_CMD);    /* 设置对比度命令(双字节命令），第1个字节是命令，第2个字节是对比度参数0-255 */
    OLED_WR_Byte(para,OLED_CMD); /* 设置对比度参数,缺省CF */
}

//清屏函数,清完屏,整个屏幕是黑色的!和没点亮一样!!!
void OLED_Clear(uint8_t para)
{
    uint16_t i,n;
    for(i=0; i<8; i++)
    for(n=0; n<128; n++)
    OLED_GRAM[n][i]=0X00;

    if(para)
    {
        OLED_Refresh_Gram();//更新显示
    }
}

//画点
//x:0~127
//y:0~63
//t:1 填充 0,清空
void OLED_DrawPoint(uint16_t x,uint16_t y,uint8_t p)
{
    uint8_t pos,bx,temp=0;
    if(x>127||y>63)return;//超出范围了.
    pos=7-y/8;
    bx=y%8;
    temp=1<<(7-bx);
    if(p)OLED_GRAM[x][pos]|=temp;
    else OLED_GRAM[x][pos]&=~temp;
}
//x1,y1,x2,y2 填充区域的对角坐标
//确保x1<=x2;y1<=y2 0<=x1<=127 0<=y1<=63
//dot:0,清空;1,填充
void OLED_Fill(uint16_t x1,uint16_t y1,uint16_t x2,uint16_t y2,uint8_t dot)
{
    uint16_t x,y;
    for(x=x1; x<x2; x++)
    {
        for(y=y1; y<y2; y++)
        {
            OLED_DrawPoint(x,y,dot);
        }
    }
}

//画线
//x1,y1:起点坐标
//x2,y2:终点坐标
void OLED_DrawLine(uint16_t x1, uint16_t y1, uint16_t x2, uint16_t y2,uint8_t dot)
{
    uint16_t t;
    int xerr=0,yerr=0,delta_x,delta_y,distance;
    int incx,incy,uRow,uCol;
    delta_x=x2-x1; //计算坐标增量
    delta_y=y2-y1;
    uRow=x1;
    uCol=y1;
    if(delta_x>0)incx=1; //设置单步方向
    else if(delta_x==0)incx=0;//垂直线
    else {
        incx=-1;
        delta_x=-delta_x;
    }
    if(delta_y>0)incy=1;
    else if(delta_y==0)incy=0;//水平线
    else {
        incy=-1;
        delta_y=-delta_y;
    }
    if( delta_x>delta_y)distance=delta_x; //选取基本增量坐标轴
    else distance=delta_y;
    for(t=0; t<=distance+1; t++ ) //画线输出
    {
        OLED_DrawPoint(uRow,uCol,dot);//画点
        xerr+=delta_x ;
        yerr+=delta_y ;
        if(xerr>distance)
        {
            xerr-=distance;
            uRow+=incx;
        }
        if(yerr>distance)
        {
            yerr-=distance;
            uCol+=incy;
        }
    }
}
//画矩形
//(x1,y1),(x2,y2):矩形的对角坐标
void OLED_DrawRectangle(uint16_t x1, uint16_t y1, uint16_t x2, uint16_t y2,uint8_t dot)
{
    OLED_DrawLine(x1,y1,x2,y1,dot);
    OLED_DrawLine(x1,y1,x1,y2,dot);
    OLED_DrawLine(x1,y2,x2,y2,dot);
    OLED_DrawLine(x2,y1,x2,y2,dot);
}
//在指定位置画一个指定大小的圆
//(x,y):中心点
//r    :半径
void OLED_Draw_Circle(uint16_t x0,uint16_t y0,uint16_t r,uint8_t dot)
{
    int a,b;
    int di;
    a=0;
    b=r;
    di=3-(r<<1);             //判断下个点位置的标志
    while(a<=b)
    {
        OLED_DrawPoint(x0+a,y0-b,dot);
        OLED_DrawPoint(x0+b,y0-a,dot);
        OLED_DrawPoint(x0+b,y0+a,dot);
        OLED_DrawPoint(x0+a,y0+b,dot);
        OLED_DrawPoint(x0-a,y0+b,dot);
        OLED_DrawPoint(x0-b,y0+a,dot);
        OLED_DrawPoint(x0-a,y0-b,dot);
        OLED_DrawPoint(x0-b,y0-a,dot);
        a++;
        //使用Bresenham算法画圆
        if(di<0)di +=4*a+6;
        else
        {
            di+=10+4*(a-b);
            b--;
        }
    }
}

//在指定位置显示一个字符,包括部分字符
//x:0~127
//y:0~63
//mode:0,反白显示;1,正常显示
//size:选择字体 12/16/24
void OLED_ShowChar(uint16_t x,uint16_t y,char chr,uint8_t size,uint8_t mode)
{
    uint16_t temp,t,t1;
    uint16_t y0=y;
    uint16_t csize=(size/8+((size%8)?1:0))*(size/2); //得到字体一个字符对应点阵集所占的字节数
    chr=chr-' ';//得到偏移后的值
    for(t=0; t<csize; t++)
    {
        if(size==12)temp=asc2_1206[chr][t]; //调用1608字体
        else if(size==16)temp=asc2_1608[chr][t];    //调用1608字体
        else return;    //没有的字库
        for(t1=0; t1<8; t1++)
        {
            if(temp&0x80)OLED_DrawPoint(x,y,mode);
            else OLED_DrawPoint(x,y,!mode);
            temp<<=1;
            y++;
            if((y-y0)==size)
            {
                y=y0;
                x++;
                break;
            }
        }
    }
}
//m^n函数
uint32_t mypow(uint8_t m,uint8_t n)
{
    uint32_t result=1;
    while(n--)result*=m;
    return result;
}
//显示2个数字
//x,y :起点坐标
//len :数字的位数
//size:字体大小
//mode:模式	0,填充模式;1,叠加模式
//num:数值(0~4294967295);
void OLED_ShowNum(uint16_t x,uint16_t y,uint32_t num,uint8_t len,uint8_t size,uint8_t mode)
{
    uint16_t t,temp;
    uint8_t enshow=0;
    for(t=0; t<len; t++)
    {
        temp=(num/mypow(10,len-t-1))%10;
        if(enshow==0&&t<(len-1))
        {
            if(temp==0)
            {
                OLED_ShowChar(x+(size/2)*t,y,' ',size,mode);
                continue;
            } else enshow=1;

        }
        OLED_ShowChar(x+(size/2)*t,y,temp+'0',size,mode);
    }
}
//显示字符串
//x,y:起点坐标
//size:字体大小
//*p:字符串起始地址
void OLED_ShowString(uint16_t x,uint16_t y,char *p,uint8_t size)
{
    while((*p<='~')&&(*p>=' '))//判断是不是非法字符!
    {
        if(x>(OLED_W -(size/2))) {
            x=0;
            y+=size;
        }
        if(y>(OLED_H -size)) {
            y=x=0;
            OLED_Clear(0);
        }
        OLED_ShowChar(x,y,*p,size,1);
        x+=size/2;
        p++;
    }

}

//初始化SSD1306
void OLED_Init(void)
{
    //使用4线SPI 串口模式
    OLED_CS_H;
    OLED_DC_H;

    OLED_RST_L;
    vTaskDelay(1);
    OLED_RST_H;
    vTaskDelay(120);

    OLED_WR_Byte(0xAE,OLED_CMD); //关闭显示
    OLED_WR_Byte(0xD5,OLED_CMD); //设置时钟分频因子,震荡频率
    OLED_WR_Byte(80,OLED_CMD);   //[3:0],分频因子;[7:4],震荡频率
    OLED_WR_Byte(0xA8,OLED_CMD); //设置驱动路数
    OLED_WR_Byte(0X3F,OLED_CMD); //默认0X3F(1/64)
    OLED_WR_Byte(0xD3,OLED_CMD); //设置显示偏移
    OLED_WR_Byte(0X00,OLED_CMD); //默认为0

    OLED_WR_Byte(0x40,OLED_CMD); //设置显示开始行 [5:0],行数.

    OLED_WR_Byte(0x8D,OLED_CMD); //电荷泵设置
    OLED_WR_Byte(0x14,OLED_CMD); //bit2，开启/关闭
    OLED_WR_Byte(0x20,OLED_CMD); //设置内存地址模式
    OLED_WR_Byte(0x02,OLED_CMD); //[1:0],00，列地址模式;01，行地址模式;10,页地址模式;默认10;
    OLED_WR_Byte(0xA1,OLED_CMD); //段重定义设置,bit0:0,0->0;1,0->127;
    OLED_WR_Byte(0xC8,OLED_CMD); //设置COM扫描方向;bit3:0,普通模式;1,重定义模式 COM[N-1]->COM0;N:驱动路数
    OLED_WR_Byte(0xDA,OLED_CMD); //设置COM硬件引脚配置
    OLED_WR_Byte(0x12,OLED_CMD); //[5:4]配置

    OLED_WR_Byte(0x81,OLED_CMD); //对比度设置
    OLED_WR_Byte(0xEF,OLED_CMD); //1~255;默认0X7F (亮度设置,越大越亮)
    OLED_WR_Byte(0xD9,OLED_CMD); //设置预充电周期
    OLED_WR_Byte(0xf1,OLED_CMD); //[3:0],PHASE 1;[7:4],PHASE 2;
    OLED_WR_Byte(0xDB,OLED_CMD); //设置VCOMH 电压倍率
    OLED_WR_Byte(0x30,OLED_CMD); //[6:4] 000,0.65*vcc;001,0.77*vcc;011,0.83*vcc;

    OLED_WR_Byte(0xA4,OLED_CMD); //全局显示开启;bit0:1,开启;0,关闭;(白屏/黑屏)
    OLED_WR_Byte(0xA6,OLED_CMD); //设置显示方式;bit0:1,反相显示;0,正常显示
    OLED_WR_Byte(0xAF,OLED_CMD); //开启显示
    OLED_Clear(0);
}

//读点
//x:0~127
//y:0~63
uint8_t OLED_ReadPoint(uint16_t x,uint16_t y)
{
    uint16_t pos,bx,temp=0x00;
    //x = 127-x;
    y = 63-y;
    pos=y/8;
    bx=y%8;
    temp=1<<bx;
    if(temp&OLED_GRAM[x][pos]) return 1;
    return 0;
}

const char* font1616_table =
{
    "已连接掉线无遥控器断开中飞行模式时间电池压流量马达机速度角高定手动自点块传感数据原始等待法充气制可标志一键起降落帧信号强三参配置姿态位磁场解算检重力方向油门源低请倒计睡眠关停悬翻抛轴"
};

const unsigned char font_1616[100][32]= {
{0x00,0x00,0x00,0x00,0x47,0xFC,0x41,0x02,0x41,0x02,0x41,0x02,0x41,0x02,0x41,0x02,
0x41,0x02,0x41,0x02,0x41,0x02,0x7F,0x02,0x00,0x02,0x00,0x1E,0x00,0x00,0x00,0x00},/*"已",0*/
{0x02,0x00,0x02,0x02,0x42,0x04,0x33,0xF8,0x00,0x04,0x20,0x22,0x22,0x22,0x26,0x22,
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0x08,0x42,0x08,0x42,0xFF,0xFE,0x08,0x42,0x08,0x42,0x0F,0xFF,0x00,0x00,0x00,0x00},/*"轴",0*/
};

//显示一个指定大小的汉字
//x,y :汉字的坐标
//font:汉字GBK码
//f_w:字宽
//f_h:字高
//mode:0,正常显示,1,叠加显示
void OLED_Show_Font(uint16_t x,uint16_t y,char *font,uint8_t f_w,uint8_t f_h,uint8_t mode)
{
    const char* font_table;
    uint16_t fontSeq;
    uint8_t temp,t,t1;
    uint16_t y0=y;
    uint8_t csize=(f_h/8+((f_h%8)?1:0))*f_w;//得到自由分辨字符所占的字节数

    if(f_w==16 && f_h==16)
    {
        font_table = font1616_table;
    }
    else
        return;/*没有的字库*/
    for(fontSeq=0; fontSeq<strlen(font_table)/2; fontSeq++)/*计算font_table对应字库的数组下标*/
    {
        if(font_table[2*fontSeq]==font[0] && font_table[2*fontSeq+1]==font[1])
            break;
    }
    if(fontSeq >= strlen(font_table)/2) return;/*font_table中没有font该字*/

    for(t=0; t<csize; t++)
    {
        if(f_w==16 && f_h==16)
        {
            temp = font_1616[fontSeq][t];
        }
        for(t1=0; t1<8; t1++)
        {
            if(temp&0x80)
                OLED_DrawPoint(x,y,mode);
            else 
                OLED_DrawPoint(x,y,!mode);
            temp<<=1;
            y++;
            if((y-y0)==f_h)
            {
                y=y0;
                x++;
                break;
            }
        }
    }
}

//在指定位置开始显示一个字符串
//支持自动换行
//(x,y):起始坐标
//width,height:区域
//str  :字符串
//f_w:字宽
//f_h:字高
//mode:0,非叠加方式;1,叠加方式
void OLED_Show_Str(uint16_t x,uint16_t y,char *str,uint8_t f_h,uint8_t mode)
{
    uint16_t x0=x;
    uint16_t y0=y;
    uint8_t bHz=0;      //字符或者中文
    while(*str!=0)      //数据未结束
    {
        if(!bHz)
        {
            if((unsigned char)(*str)>0x80)
            {
                bHz=1;//中文
            }
            else               //字符
            {
                if(x>(x0+OLED_W - f_h / 2))//换行
                {
                    y+=f_h;
                    x=x0;
                }
                if(y>(y0+OLED_H-f_h))break;//越界返回
                if(*str==13)//换行符号
                {
                    y+=f_h;
                    x=x0;
                    str++;
                }
                else OLED_ShowChar(x,y,*str,f_h,mode);//有效部分写入
                str++;
                x+=f_h/2; //字符,为全字的一半
            }
        }
        else//中文
        {
            bHz=0;//有汉字库
            if(x>(x0+OLED_W -f_h))//换行
            {
                y+=f_h+2;//2为行间距
                x=x0;
            }
            if(y>(y0+OLED_H-f_h))break;//越界返回
            OLED_Show_Font(x,y,str,f_h,f_h,mode); //显示这个汉字,空心显示
            str+=2;
            x+=f_h;//下一个汉字偏移
        }
    }
}

#include "math.h"

#define D2RVAL 0.01745329f //0.01745329251994329576923690768489f
#define R2DVAL 57.2957795f  //57.295779513082320876798154814105f

//三维坐标点
typedef struct
{
    float x;
    float y;
    float z;
}point_3d;
//二维坐标点
typedef struct
{
    float x;
    float y;
}point_2d;

//线段数
#define LINE_NUM 8

//线段三维端点、二维坐标
point_3d main_point_3d[LINE_NUM];
point_2d main_point_2d[LINE_NUM];

//单位旋转矢量
float main_matrix[4][4];

//连接点数据
int connect_arrays[12][2]=
{
    {0,1},
    {0,2},
    {0,3},
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    {7,8},
};

void Structure_3D(float MAT[4][4])
{
    MAT[0][0]=1;
    MAT[0][1]=0;
    MAT[0][2]=0;
    MAT[0][3]=0;// 1 0 0 0
    MAT[1][0]=0;
    MAT[1][1]=1;
    MAT[1][2]=0;
    MAT[1][3]=0;// 0 1 0 0
    MAT[2][0]=0;
    MAT[2][1]=0;
    MAT[2][2]=1;
    MAT[2][3]=0;// 0 0 1 0
    MAT[3][0]=0;
    MAT[3][1]=0;
    MAT[3][2]=0;
    MAT[3][3]=1;// 0 0 0 1
}

void MATRIX_copy(float sourceMAT[4][4],float targetMAT[4][4])
{
    int a,b;
    for(a=0; a<4; a++)
    {
        for(b=0; b<4; b++)
        {
            targetMAT[a][b]=sourceMAT[a][b];
        }
    }
}

void MATRIX_multiply(float MAT1[4][4],float MAT2[4][4],float newMAT[4][4])
{
    int a,b;
    for(a=0; a<4; a++)
    {
        for(b=0; b<4; b++)
        {
            newMAT[a][b]=MAT1[a][0]*MAT2[0][b]+MAT1[a][1]*MAT2[1][b]+\
                    MAT1[a][2]*MAT2[2][b]+MAT1[a][3]*MAT2[3][b];
        }
    }
}

void Translate3D(float MAT[4][4],int16_t tx,int16_t ty,int16_t tz)
{
    float lMAT[4][4];
    float tMAT[4][4];
    tMAT[0][0]=1;
    tMAT[0][1]=0;
    tMAT[0][2]=0;
    tMAT[0][3]=tx;	//	1 0 0 tx
    tMAT[1][0]=0;
    tMAT[1][1]=1;
    tMAT[1][2]=0;
    tMAT[1][3]=ty;	//	0 1 0 ty
    tMAT[2][0]=0;
    tMAT[2][1]=0;
    tMAT[2][2]=1;
    tMAT[2][3]=tz;	//	0 0 1 tz
    tMAT[3][0]=0;
    tMAT[3][1]=0;
    tMAT[3][2]=0;
    tMAT[3][3]=1;	//	0 0 0 1
    MATRIX_multiply(MAT,tMAT,lMAT); //相乘
    MATRIX_copy(lMAT,MAT);          //复制
}

void  Scale_3D(float MAT[4][4],float sx,float sy,float sz)
{
    float lMAT[4][4];
    float tMAT[4][4];
    tMAT[0][0]=sx;
    tMAT[0][1]=0;
    tMAT[0][2]=0;
    tMAT[0][3]=0;	//	sx0 0 0
    tMAT[1][0]=0;
    tMAT[1][1]=sy;
    tMAT[1][2]=0;
    tMAT[1][3]=0;	//	0 sy0 0
    tMAT[2][0]=0;
    tMAT[2][1]=0;
    tMAT[2][2]=sz;
    tMAT[2][3]=0;	//	0 0 sz0
    tMAT[3][0]=0;
    tMAT[3][1]=0;
    tMAT[3][2]=0;
    tMAT[3][3]=1;	//	0 0 0 1
    MATRIX_multiply(MAT,tMAT,lMAT);	//相乘
    MATRIX_copy(lMAT,MAT);          //复制
}

void Rotate_3D(float MAT[4][4],float ax,float ay,float az)
{
    float MAT1[4][4];
    float MAT2[4][4];
    float MATx[4][4];
    float MATy[4][4];
    float MATz[4][4];

    ax = D2RVAL * ax;	//角度转换为弧度量
    ay = D2RVAL * ay;
    az = D2RVAL * az;
    /*****************************绕x轴旋转********************************************/

    MATx[0][0]=1;
    MATx[0][1]=0;
    MATx[0][2]=0;
    MATx[0][3]=0;//1        0        0              0
    MATx[1][0]=0;
    MATx[1][1]=cos(ax);
    MATx[1][2]=-sin(ax);
    MATx[1][3]=0;//0        cos(ax)  -sin(ax)       0
    MATx[2][0]=0;
    MATx[2][1]=sin(ax);
    MATx[2][2]=cos(ax);
    MATx[2][3]=0;//0        sin(ax)   cos(ax)       0
    MATx[3][0]=0;
    MATx[3][1]=0;
    MATx[3][2]=0;
    MATx[3][3]=1;//0        0        0              1

    /*****************************绕y轴旋转********************************************/
    MATy[0][0]=cos(ay);
    MATy[0][1]=0;
    MATy[0][2]=sin(ay);
    MATy[0][3]=0;//cos(ay)  0     sin(ay)   0
    MATy[1][0]=0;
    MATy[1][1]=1;
    MATy[1][2]=0;
    MATy[1][3]=0;//0        1     0         0
    MATy[2][0]=-sin(ay);
    MATy[2][1]=0;
    MATy[2][2]=cos(ay);
    MATy[2][3]=0;//-sin(ay) 0     cos(ay)   0
    MATy[3][0]=0;
    MATy[3][1]=0;
    MATy[3][2]=0;
    MATy[3][3]=1;//0        0     0         1

    /*****************************绕z轴旋转********************************************/
    MATz[0][0]=cos(az);
    MATz[0][1]=-sin(az);
    MATz[0][2]=0;
    MATz[0][3]=0;//cos(az) -sin(az)  0       0
    MATz[1][0]=sin(az);
    MATz[1][1]=cos(az);
    MATz[1][2]=0;
    MATz[1][3]=0;//sin(az)  cos(az)  0       0
    MATz[2][0]=0;
    MATz[2][1]=0;
    MATz[2][2]=1;
    MATz[2][3]=0;//0       0         1       0
    MATz[3][0]=0;
    MATz[3][1]=0;
    MATz[3][2]=0;
    MATz[3][3]=1;//0       0         0       1

    MATRIX_multiply(MAT,MATx,MAT1);
    MATRIX_multiply(MAT1,MATy,MAT2);
    MATRIX_multiply(MAT2,MATz,MAT);
}

point_3d vector_matrix_MULTIPLY(point_3d Source,float MAT[4][4])
{
    point_3d Result;
    Result.x=Source.x*MAT[0][0]+Source.y*MAT[1][0]+Source.z*MAT[2][0]+MAT[3][0];
    Result.y=Source.x*MAT[0][1]+Source.y*MAT[1][1]+Source.z*MAT[2][1]+MAT[3][1];
    Result.z=Source.x*MAT[0][2]+Source.y*MAT[1][2]+Source.z*MAT[2][2]+MAT[3][2];
    return Result;
}

point_2d OrtProject(point_3d Space)
{
    point_2d Screen;
    Screen.x=(int16_t)Space.x;
    Screen.y=(int16_t)Space.y;
    return Screen;
}

#define FOCAL_DISTANCE 1024  //视点到平面的距离

point_2d PerProject(point_3d Space,int16_t XO,int16_t YO)
{
    point_2d Screen;
    if(Space.z == 0)
    Space.z = 1;
    Screen.x = (int16_t)(FOCAL_DISTANCE * Space.x /(Space.z + FOCAL_DISTANCE) + XO);
    Screen.y = (int16_t)(FOCAL_DISTANCE * Space.y /(Space.z + FOCAL_DISTANCE) + YO);
    return Screen;
}

const point_3d point_cude[8]=
{
    {-1,-1,-1},
    { 1,-1,-1},
    {-1, 1,-1},
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    { 1, 1, 1},
};

void main_3d_loop(float x,float y,float z)
{
    static uint8_t flag = 0;
    
    uint8_t i;
    uint8_t x1,y1,x2,y2;
    
    Structure_3D(main_matrix);
    Scale_3D(main_matrix,15,15,15);
    Rotate_3D(main_matrix,x,y,z);
    
    point_3d temp;
    point_2d res;
    for(i=0;i<LINE_NUM;i++)
    {
        temp = vector_matrix_MULTIPLY(point_cude[i],main_matrix);
        res = PerProject(temp,96,32);
        main_point_2d[i].x = res.x;
        main_point_2d[i].y = res.y;
    }
    
    OLED_DrawLine(main_point_2d[0].x,main_point_2d[0].y,main_point_2d[1].x,main_point_2d[1].y,1);
    OLED_DrawLine(main_point_2d[0].x,main_point_2d[0].y,main_point_2d[2].x,main_point_2d[2].y,1);
    OLED_DrawLine(main_point_2d[3].x,main_point_2d[3].y,main_point_2d[1].x,main_point_2d[1].y,1);
    OLED_DrawLine(main_point_2d[3].x,main_point_2d[3].y,main_point_2d[2].x,main_point_2d[2].y,1);
    
    OLED_DrawLine(main_point_2d[0+4].x,main_point_2d[0+4].y,main_point_2d[1+4].x,main_point_2d[1+4].y,1);
    OLED_DrawLine(main_point_2d[0+4].x,main_point_2d[0+4].y,main_point_2d[2+4].x,main_point_2d[2+4].y,1);
    OLED_DrawLine(main_point_2d[3+4].x,main_point_2d[3+4].y,main_point_2d[1+4].x,main_point_2d[1+4].y,1);
    OLED_DrawLine(main_point_2d[3+4].x,main_point_2d[3+4].y,main_point_2d[2+4].x,main_point_2d[2+4].y,1);

    OLED_DrawLine(main_point_2d[0].x,main_point_2d[0].y,main_point_2d[0+4].x,main_point_2d[0+4].y,1);
    OLED_DrawLine(main_point_2d[1].x,main_point_2d[1].y,main_point_2d[1+4].x,main_point_2d[1+4].y,1);
    OLED_DrawLine(main_point_2d[2].x,main_point_2d[2].y,main_point_2d[2+4].x,main_point_2d[2+4].y,1);
    OLED_DrawLine(main_point_2d[3].x,main_point_2d[3].y,main_point_2d[3+4].x,main_point_2d[3+4].y,1);
}
